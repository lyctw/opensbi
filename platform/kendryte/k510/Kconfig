## platform/kendryte/k510/Kconfig
```kconfig
# SPDX-License-Identifier: BSD-2-Clause

config PLATFORM_KENDRYTE_K510
	bool
	select FDT
	select FDT_SERIAL
	select FDT_SERIAL_UART8250
	select FDT_TIMER
	select FDT_TIMER_PLMT
	select FDT_IRQCHIP
	select FDT_IRQCHIP_PLIC
	select FDT_IPI
	select FDT_IPI_PLICSW
	default y
```

## platform/renesas/rzf-dev/Kconfig
```kconfig
# SPDX-License-Identifier: BSD-2-Clause

config PLATFORM_RENESAS_RZFIVE
	bool
	select FDT
	select FDT_SERIAL
	select FDT_SERIAL_SCIF
	select FDT_TIMER
	select FDT_TIMER_PLMT
	select FDT_IRQCHIP
	select FDT_IRQCHIP_PLIC
	default y

if PLATFORM_RENESAS_RZFIVE

config PLATFORM_RENESAS_RZFIVE_NAME
	string "Platform default name"
	default "Renesas RZ/Five"

config PLATFORM_RENESAS_RZFIVE_MAJOR_VER
	int "Platform major version"
	range 0 65535
	default 0

config PLATFORM_RENESAS_RZFIVE_MINOR_VER
	int "Platform minor version"
	range 0 65535
	default 1

endif
```
